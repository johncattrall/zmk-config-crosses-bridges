## config/west.yml
```yaml
manifest:
  defaults:
    revision: v0.3
  remotes:
    - name: zmkfirmware
      url-base: https://github.com/zmkfirmware
    - name: Good-Great-Grand-Wonderful
      url-base: https://github.com/Good-Great-Grand-Wonderful
    - name: johncattrall
      url-base: https://github.com/johncattrall
    - name: urob
      url-base: https://github.com/urob
    - name: kot149
      url-base: https://github.com/kot149
    - name: zettaface
      url-base: https://github.com/zettaface
  projects:
    - name: zmk
      remote: zmkfirmware
      import: app/west.yml
    - name: gggw-zmk-keebs
      remote: johncattrall
      revision: main
      import: config/west.yml
    - name: zmk-auto-layer
      remote: urob
      revision: v0.3
    - name: zmk-scroll-snap
      remote: kot149
      revision: v1
    - name: zmk-input-processor-keybind
      remote: zettaface
      revision: main
  self:
    path: config
```
